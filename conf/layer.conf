## conf/layer.conf
```bitbake
BBPATH .= ":${LAYERDIR}"
BBFILES += "${LAYERDIR}/recipes-*/*/*.bb"
BBFILE_COLLECTION += "eyitope"
BBFILE_PATTERN_eyitope = "^${LAYERDIR}/"

LAYERSERIES_COMPAT_eyitope = "kirkstone"
LAYERVERSION_eyitope = "1"

IMAGE_INSTALL:append = " spp"
```
